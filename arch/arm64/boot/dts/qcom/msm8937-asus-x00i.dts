// SPDX-License-Identifier: BSD-3-Clause
/*
 * Copyright (c) 2025, Barnabas Czeman
 */

/dts-v1/;

#include <dt-bindings/arm/qcom,ids.h>
#include <dt-bindings/gpio/gpio.h>
#include <dt-bindings/leds/common.h>
#include "msm8937.dtsi"
#include "pmi8950.dtsi"
#include "pm8937.dtsi"
#include "msm8937-qdsp6.dtsi"

/delete-node/ &qseecom_mem;

/ {
	model = "Asus Zenphone 4 Pro Max (x00i)";
	compatible = "asus,x00i", "qcom,msm8937";
	qcom,msm-id = <QCOM_ID_MSM8937 0>;
	qcom,board-id = <0x46 0x8000>,
			<0x47 0x8000>;
	chassis-type = "handset";
};
